## config/west.yml
```yaml
manifest:
  remotes:
    - name: zmkfirmware
      url-base: https://github.com/zmkfirmware
    - name: keebJP
      url-base: https://github.com/keebJP
    - name: mjmjm0101
      url-base: https://github.com/mjmjm0101
  projects:
    - name: zmk
      remote: zmkfirmware
      revision: v0.3-branch
      import: app/west.yml
    - name: zmk-pmw3610-driver
      remote: keebJP
      revision: main
    - name: zmk-input-processor-scroll-inertia
      remote: mjmjm0101
      revision: main
  self:
    path: config
```
